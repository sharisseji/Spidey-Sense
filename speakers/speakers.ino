#include <Wire.h>
#include "Adafruit_TPA2016.h"

#include <PCM.h>
#include <avr/pgmspace.h>
#include "morepcms.h"

Adafruit_TPA2016 audioamp = Adafruit_TPA2016();
// extern const unsigned char obstruction[];
// extern const unsigned char person[];

const unsigned char vehicle[] PROGMEM = {
  129, 129, 129, 128, 128, 128, 128, 127, 127, 127, 127, 126,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 128, 
};
const unsigned char animal[] PROGMEM = {
129, 128, 129, 130, 128, 132, 134, 129, 130, 132, 128, 128,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 127,};

// const unsigned int obstructionLength = sizeof(obstruction);
// const unsigned int personLength = sizeof(person);
const unsigned int vehicleLength = sizeof(vehicle);
const unsigned int animalLength = sizeof(animal);
int data; 

#define PERSON_PIN 6  // Match ESP32-CAM GPIO
#define VEHICLE_PIN 7   // Match ESP32-CAM GPIO
#define ANIMAL_PIN 8  // Match ESP32-CAM GPIO
#define OBST_PIN 9   // Match ESP32-CAM GPIO

void setup() {
    Serial.begin(9600);
    Wire.begin();
    pinMode(PERSON_PIN, INPUT);
    pinMode(VEHICLE_PIN, INPUT);
    pinMode(ANIMAL_PIN, INPUT);
    pinMode(OBST_PIN, INPUT);
  
    Serial.println("Initializing TPA2016 for Right Channel...");
    if (!audioamp.begin()) {
        Serial.println("Failed to find TPA2016. Check wiring!");
        while (1);
    }
    
    // Set gain and enable only the right channel
    Serial.println("Left On, Right off");
    audioamp.enableChannel(true, false);
    delay(1000);

    Serial.println("TPA2016 Initialized.");
    Serial.println("Playing PCM audio...");

    // if (digitalRead(PERSON_PIN) == HIGH) {
    // // tone(9, 1000, 5000);
    //   Serial.println("Person Detected");  
    //   startPlayback(person, personLength);
          
    // } else if (digitalRead(VEHICLE_PIN) == HIGH) {
    //   // noTone(9);
    //   Serial.println("Vehicle Detected");
    //   startPlayback(vehicle, vehicleLength);
      
    // }
    // else if (digitalRead(ANIMAL_PIN) == HIGH) {
    //   // noTone(9);
    //   Serial.println("Animal Detected");
    //   //Serial.println("Vehicle Detected");
    // }
    // else if (digitalRead(OBST_PIN) == HIGH) {
    //   // noTone(9);
    //   //startPlayback(obstruction, obstructionLength);
    //   Serial.println("Obstruction Detected");    
    // }
    // // for (int8_t i=-28; i<=30; i++) {
    // //   Serial.print("Gain = "); Serial.println(i);
    // //   audioamp.setGain(i);
    // //   Serial.println("Playing PCM audio...");
    // //   if (data == 1) {
    // //     startPlayback(obstruction, obstructionLength);
    // //   } else if (data == 2) {
    // //     startPlayback(person, personLength);
    // //   } else if (data == 3) {
    // //     startPlayback(vehicle, vehicleLength);
    // //   }
      
    // delay(3000);
    
}

void loop() {
    // Nothing needed, playback happens automatically
    if (digitalRead(PERSON_PIN) == HIGH) {
    // tone(9, 1000, 5000);
      Serial.println("Person Detected");  
      startPlayback(person, personLength);
          
    } else if (digitalRead(VEHICLE_PIN) == HIGH) {
      // noTone(9);
      Serial.println("Vehicle Detected");
      startPlayback(vehicle, vehicleLength);
      
    }
    else if (digitalRead(ANIMAL_PIN) == HIGH) {
      // noTone(9);      
      Serial.println("Animal Detected");
      startPlayback(animal, animalLength);
      //Serial.println("Vehicle Detected");
    }
    else if (digitalRead(OBST_PIN) == HIGH) {
      // noTone(9);      
      Serial.println("Obstruction Detected"); 
      startPlayback(obstruction, obstructionLength);   
    }
    // for (int8_t i=-28; i<=30; i++) {
    //   Serial.print("Gain = "); Serial.println(i);
    //   audioamp.setGain(i);
    //   Serial.println("Playing PCM audio...");
    //   if (data == 1) {
    //     startPlayback(obstruction, obstructionLength);
    //   } else if (data == 2) {
    //     startPlayback(person, personLength);
    //   } else if (data == 3) {
    //     startPlayback(vehicle, vehicleLength);
    //   }
      
    delay(3000);
}
